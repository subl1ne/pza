#include <Adafruit_GFX.h>
#include <gfxfont.h>
#include <Servo.h>
#include <Adafruit_PCD8544.h>
#include <SPI.h>
#include <Keypad.h>
#include <math.h>
#include <TinyGPS.h>
#include <SoftwareSerial.h>

#define RXPIN 13
#define TXPIN 12
#define GPSBAUD 9600

const unsigned char PROGMEM logobmp[] = {
  0x0, 0x0, 0x0, 0x0, 0x0, 0x0, 0x0, 0x0, 0x0, 0x0, 0x0,
  0x0, 0x0, 0x0, 0x0, 0x0, 0x0, 0x0, 0x0, 0x0, 0x0, 0x0,
  0x0, 0x0, 0x0, 0x0, 0x0, 0x0, 0x0, 0x0, 0x0, 0x0, 0x0,
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  0x0, 0x0, 0x0, 0x0, 0x8, 0x0, 0x0, 0x0, 0x0, 0x0, 0x0
};
const unsigned char PROGMEM dolgotaspbmp[] = {
  0x0, 0x0, 0x0, 0x0, 0x0, 0x0, 0x0, 0x0, 0x0, 0x0, 0x0, 
0x0, 0x0, 0x0, 0x0, 0x0, 0x0, 0x0, 0x0, 0x0, 0x0, 0x0, 
0x7f, 0x0, 0x0, 0x0, 0x0, 0x0, 0x0, 0x0, 0x0, 0x0, 0x0, 
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0x0, 0x0, 0x0, 0x0, 0x0, 0x0, 0x0, 0x0, 0x0, 0x0, 0x0
  };
const unsigned char PROGMEM shirotabmp[] = {
  0x0, 0x0, 0x0, 0x0, 0x0, 0x0, 0x0, 0x0, 0x0, 0x0, 0x0, 
0x0, 0x0, 0x0, 0x0, 0x0, 0x0, 0x0, 0x0, 0x0, 0x0, 0x0, 
0x6b, 0x0, 0x0, 0x0, 0x0, 0x0, 0x0, 0x0, 0x0, 0x0, 0x0, 
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0x0, 0x0, 0x0, 0x0, 0x0, 0x0, 0x0, 0x0, 0x0, 0x0, 0x0
  };
const unsigned char PROGMEM dolgotambmp[] = {
  0x0, 0x0, 0x0, 0x0, 0x0, 0x0, 0x0, 0x0, 0x0, 0x0, 0x0, 
0x0, 0x0, 0x0, 0x0, 0x0, 0x0, 0x0, 0x0, 0x0, 0x0, 0x0, 
0x7f, 0x0, 0x0, 0x0, 0x0, 0x0, 0x0, 0x0, 0x0, 0x0, 0x0, 
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0x0, 0x0, 0x0, 0x0, 0x0, 0x0, 0x0, 0x0, 0x0, 0x0, 0x0
  };
const unsigned char PROGMEM gpsbmp[] = {
  0x0, 0x0, 0x0, 0x0, 0x0, 0x0, 0x0, 0x0, 0x0, 0x0, 0x0, 
0x0, 0x0, 0x0, 0x0, 0x0, 0x0, 0x0, 0x0, 0x0, 0x0, 0x0, 
0x0, 0x0, 0x0, 0x0, 0x0, 0x0, 0x0, 0x0, 0x0, 0x0, 0x0, 
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0x0, 0x0, 0x0, 0x0, 0x2, 0x0, 0x0, 0x0, 0x0, 0x0, 0x0
  };
const unsigned char PROGMEM menul1bmp[] = {
0x0, 0x0, 0x0, 0x0, 0x0, 0x0, 0x0, 0x0, 0x0, 0x0, 0x0, 
0x0, 0x0, 0x0, 0x0, 0x0, 0x0, 0x0, 0x0, 0x0, 0x0, 0x0, 
0x0, 0x0, 0x0, 0x0, 0x0, 0x0, 0x0, 0x0, 0x0, 0x0, 0x0, 
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0x0, 0x0, 0x0, 0x0, 0x0, 0x0, 0x0, 0x0, 0x0, 0x0, 0x0  
};
const unsigned char PROGMEM menul2bmp[] = {
0x0, 0x0, 0x0, 0x0, 0x0, 0x0, 0x0, 0x0, 0x0, 0x0, 0x0, 
0x0, 0x0, 0x0, 0x0, 0x0, 0x0, 0x0, 0x0, 0x0, 0x0, 0x0, 
0x0, 0x0, 0x0, 0x0, 0x0, 0x0, 0x0, 0x0, 0x0, 0x0, 0x0, 
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0x0, 0x0, 0x0, 0x0, 0x0, 0x0, 0x0, 0x0, 0x0, 0x0, 0x0  
};
const unsigned char PROGMEM menul3bmp[] = {
  0x0, 0x0, 0x0, 0x0, 0x0, 0x0, 0x0, 0x0, 0x0, 0x0, 0x0, 
0x0, 0x0, 0x0, 0x0, 0x0, 0x0, 0x0, 0x0, 0x0, 0x0, 0x0, 
0x0, 0x0, 0x0, 0x0, 0x0, 0x0, 0x0, 0x0, 0x0, 0x0, 0x0, 
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0x0, 0x0, 0x0, 0x0, 0x0, 0x0, 0x0, 0x0, 0x0, 0x0, 0x0
};
const unsigned char PROGMEM menul4bmp[] = {
  0x0, 0x0, 0x0, 0x0, 0x0, 0x0, 0x0, 0x0, 0x0, 0x0, 0x0, 
0x0, 0x0, 0x0, 0x0, 0x0, 0x0, 0x0, 0x0, 0x0, 0x0, 0x0, 
0x0, 0x0, 0x0, 0x0, 0x0, 0x0, 0x0, 0x0, 0x0, 0x0, 0x0, 
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0x0, 0x0, 0x0, 0x0, 0x0, 0x0, 0x0, 0x0, 0x0, 0x0, 0x0
};
const unsigned char PROGMEM menul5bmp[] = {
  0x0, 0x0, 0x0, 0x0, 0x0, 0x0, 0x0, 0x0, 0x0, 0x0, 0x0, 
0x0, 0x0, 0x0, 0x0, 0x0, 0x0, 0x0, 0x0, 0x0, 0x0, 0x0, 
0x0, 0x0, 0x0, 0x0, 0x0, 0x0, 0x0, 0x0, 0x0, 0x0, 0x0, 
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0x0, 0x0, 0x0, 0x0, 0x0, 0x0, 0x0, 0x0, 0x0, 0x0, 0x0
};
const unsigned char PROGMEM Dolgotabmp[] = {
  0x0, 0x0, 0x0, 0x0, 0x0, 0x0, 0x0, 0x0, 0x0, 0x0, 0x0, 
0x0, 0x0, 0x0, 0x0, 0x0, 0x0, 0x0, 0x0, 0x0, 0x0, 0x0, 
0x0, 0x0, 0x0, 0x0, 0x0, 0x0, 0x0, 0x0, 0x0, 0x0, 0x0, 
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0x0, 0x0, 0x0, 0x0, 0x0, 0x0, 0x0, 0x0, 0x0, 0x0, 0x0
};
const unsigned char PROGMEM Shirotabmp[] = {
0x0, 0x0, 0x0, 0x0, 0x0, 0x0, 0x0, 0x0, 0x0, 0x0, 0x0, 
0x0, 0x0, 0x0, 0x0, 0x0, 0x0, 0x0, 0x0, 0x0, 0x0, 0x0, 
0x0, 0x0, 0x0, 0x0, 0x0, 0x0, 0x0, 0x0, 0x0, 0x0, 0x0, 
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0x0, 0x0, 0x0, 0x0, 0x0, 0x0, 0x0, 0x0, 0x0, 0x0, 0x0
};
const unsigned char PROGMEM Kompasbmp[] = {
0x0, 0x0, 0x0, 0x0, 0x0, 0x0, 0x0, 0x0, 0x0, 0x0, 0x0, 
0x0, 0x0, 0x0, 0x0, 0x0, 0x0, 0x0, 0x0, 0x0, 0x0, 0x0, 
0x0, 0x0, 0x0, 0x0, 0x0, 0x0, 0x0, 0x0, 0x0, 0x0, 0x0, 
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0x0, 0x0, 0x0, 0x0, 0x0, 0x0, 0x0, 0x0, 0x0, 0x0, 0x0
};
/*const unsigned char PROGMEM Kompasbmp[] = {
  
}*/




const byte ROWS = 4;
const byte COLS = 3;
const int  servoPin = 8;
const int  ver = A0;
const int  gor = A1;
const int  dolgotaSputnikPin = 29;
const int  dolgotaMestaPin = 30;
const int  shirotaPin = 33;
const int  angleKPin = 51;
const int  vperedButtonPin = 53;
const int  nazadButtonPin = 44;
const int  gpsButton = 50;
const int  infopin = 52;
const int  resetButtonPin = 41;
const int  LedDolgotaSputnikPin = 24;
const int  LedDolgotaMestaPin = 27;
const int  LedShirotaPin = 26;
const int  LedRabotaPinRed = 28;
const int  LedPitaniePin = 31;
const int  ServoPitaniePin = 25;
const int  MenuPin = 6;
int seconds;
int timeoffset = 2; // Пользователь должен изменить единицу на соответствующий часовой пояс
int  shirotaButton = 0;
int  dolgotaMestaButton = 0;
int  dolgotaSputnikButton = 0;
int  MenuButton = 0;
float  dolgotaSputnikNum, dolgotaMestaNum, shirotaNum, speedd;
int  angleKButton = 0;
float  angleKNum, azimut, ugolmesta; 
char kpress;
int counter = 0;



TinyGPS gps;
SoftwareSerial uart_gps(RXPIN, TXPIN);

Adafruit_PCD8544 display = Adafruit_PCD8544(45, 42, 49, 48, 47);
Servo servo;
void getgps(TinyGPS &gps);
char keys[ROWS][COLS] = {
  {'C', '0', '-'},
  {'9', '8', '7'},
  {'6', '5', '4'},
  {'3', '2', '1'}
};
byte rowPins[ROWS] = {36, 39, 38, 32}; 
byte colPins[COLS] = {35, 34, 43};
Keypad keypad = Keypad( makeKeymap(keys), rowPins, colPins, ROWS, COLS);

struct MOTOR    // структура для хранения номеров pin-ов, к которым подключены моторчики
{
  int in1;      // INPUT1
  int in2;      // INPUT2
  int enable;   // ENABLE1
};

MOTOR MOTOR1 = { 22, 23, 9 };

void setup() {
  uart_gps.begin(GPSBAUD);
  pinMode(dolgotaSputnikPin, INPUT);
  pinMode(dolgotaMestaPin, INPUT);
  pinMode(shirotaPin, INPUT);
  pinMode(angleKPin, INPUT);
  pinMode(MenuPin, INPUT);
  pinMode(gor, INPUT);
  pinMode(ver, INPUT);
  pinMode(ServoPitaniePin, OUTPUT);
  pinMode(2, OUTPUT);
  pinMode(3, OUTPUT);
  pinMode(9, OUTPUT);
  pinMode (resetButtonPin, INPUT);
  pinMode (gpsButton, INPUT);
  pinMode(7, OUTPUT);
  digitalWrite(LedRabotaPinRed, LOW);
  digitalWrite(LedPitaniePin, HIGH);
  digitalWrite(ServoPitaniePin, HIGH);
  pinMode(46, OUTPUT);
  digitalWrite(46, HIGH);
  keypad.begin( makeKeymap(keys) );
 // servo.attach(servoPin);
 // servo.write(30);
 servo.detach();
servo.attach(8);
  delay(2000);
  display.begin();
  display.clearDisplay();
  display.display();
  display.setTextSize(1);
  display.setContrast(55);
  display.drawBitmap(0, 0, logobmp, 84, 44, BLACK);
  display.display();
  delay(2000);
  melody();
  display.clearDisplay();
  display.display();

}

void loop() {

  shirotaButton = digitalRead(shirotaPin);
  dolgotaMestaButton = digitalRead(dolgotaMestaPin);
  dolgotaSputnikButton = digitalRead(dolgotaSputnikPin);
  MenuButton = digitalRead(MenuPin);
  ShirotaChange();
  DolgotaMestaChange();
  dolgotaSputnikChange();
  AngleCalc();
  vpered();
  nazad();
  resets();
  gpss();
  menu();
 

}
void (* resetFunc)(void) = 0;
void resets() {
  while (digitalRead(resetButtonPin) == HIGH) {
    digitalWrite(ServoPitaniePin, LOW);
    resetFunc();


  }
  digitalWrite(ServoPitaniePin, HIGH);
}
void vpered() {
  while (digitalRead(vperedButtonPin) == HIGH) {
    digitalWrite(LedRabotaPinRed, HIGH);
    forward(200);
  }
  forward(0);
}
void nazad() {
  while (digitalRead(nazadButtonPin) == HIGH) {
    digitalWrite(LedRabotaPinRed, HIGH);
    back(200);
  }
  back(0);
}
void ShirotaChange() {
  while (shirotaButton == HIGH)  {
    shirotaButton = digitalRead(shirotaPin);
    kpress = keypad.getKey();
    display.clearDisplay();
    display.drawBitmap(0, 0, shirotabmp, 84, 44, BLACK);
    display.setCursor(0,30);
    display.print(shirotaNum);
    display.display();
    digitalWrite(LedShirotaPin, HIGH);

    if (kpress == 'C')
    {
      shirotaNum = 0;
      display.clearDisplay();
      display.display();

    }
    if ( kpress >= '0' && kpress <= '9')
    {
      shirotaNum = shirotaNum * 10 + (kpress - '0');

    }
    if (kpress == '-') {
      shirotaNum = shirotaNum - shirotaNum * 2;
    }
    if (shirotaButton == LOW)
    {
      display.clearDisplay();
      display.display();
      digitalWrite(LedShirotaPin, LOW);
      break;
    }
  }
}

void DolgotaMestaChange() {
  while (dolgotaMestaButton == HIGH)  {
    dolgotaMestaButton = digitalRead(dolgotaMestaPin);
    kpress = keypad.getKey();
    display.clearDisplay();
    display.drawBitmap(0, 0, dolgotambmp, 84, 44, BLACK);
    display.setCursor(0,30);
    display.print(dolgotaMestaNum);
    display.display();
    digitalWrite(LedDolgotaMestaPin, HIGH);

    if (kpress == 'C')
    {
      dolgotaMestaNum = 0;
      display.clearDisplay();
      display.display();

    }
    if ( kpress >= '0' && kpress <= '9')
    {
      dolgotaMestaNum = dolgotaMestaNum * 10 + (kpress - '0');

    }
    if (kpress == '-') {
      dolgotaMestaNum = dolgotaMestaNum - dolgotaMestaNum * 2;
    }
    if (dolgotaMestaButton == LOW)
    {
      display.clearDisplay();
      display.display();
      digitalWrite(LedDolgotaMestaPin, LOW);
      break;
    }
  }
}

void dolgotaSputnikChange() {

  while (dolgotaSputnikButton == HIGH)  {
    
    dolgotaSputnikButton = digitalRead(dolgotaSputnikPin);
    kpress = keypad.getKey();
    display.clearDisplay();
    display.drawBitmap(0, 0, dolgotaspbmp, 84, 44, BLACK);
    display.setCursor(0,30);
    display.print(dolgotaSputnikNum/100);
    display.display();
    digitalWrite(LedDolgotaSputnikPin, HIGH);
    if (kpress == 'C')
    {
      dolgotaSputnikNum = 0;
      display.clearDisplay();
      display.display();

    }
    if ( kpress >= '0' && kpress <= '9' )
    {
      dolgotaSputnikNum = dolgotaSputnikNum * 10 + (kpress - '0');


    }
    if (kpress == '-') {
      dolgotaSputnikNum = dolgotaSputnikNum - dolgotaSputnikNum * 2;
    }

    if (dolgotaSputnikButton == LOW)
    {
      display.clearDisplay();
      display.display();
      digitalWrite(LedDolgotaSputnikPin, LOW);
      break;
    }
  }
}



void AngleCalc() {
  angleKButton = digitalRead(infopin);
  if (angleKButton == HIGH)  {
      servo.attach(8);
    digitalWrite(LedRabotaPinRed, HIGH);
    angleKNum = 90 + (atan(sin(dolgotaMestaNum * (PI / 180) - (dolgotaSputnikNum/100) * (PI / 180)) / tan(shirotaNum * (PI / 180)))) * ( 180 / PI);

    azimut = 180 + (atan(tan(dolgotaMestaNum * (PI / 180) - (dolgotaSputnikNum/100) * (PI / 180)) / sin(shirotaNum * (PI / 180)))) * ( 180 / PI);
    ugolmesta = atan(cos(dolgotaMestaNum * (PI / 180) - (dolgotaSputnikNum/100) * (PI / 180))*cos(shirotaNum * (PI / 180))-0.151) / sqrt(1-(sq(cos(dolgotaMestaNum * (PI / 180) - (dolgotaSputnikNum/100)))) * (sq(cos(shirotaNum * (PI / 180)))))*( 180 / PI);
    servo.write(angleKNum);
    delay(1500);
    display.clearDisplay();
    display.display();
    display.println("Konvertr");
    display.println(angleKNum - 90);
    display.display();
    delay(1500);
    display.clearDisplay();
    display.display();
    display.println("Azimut");
    display.println(azimut);
    display.display();
    delay(1500);
    display.clearDisplay();
    display.display();
    display.println("Ugol Mesta");
    display.println(ugolmesta);
    display.display();
  }
  else  digitalWrite(LedRabotaPinRed, LOW);
  servo.detach();
}


void forward(int pwm) // первый вперёд
{
  digitalWrite(MOTOR1.in1, HIGH);
  digitalWrite(MOTOR1.in2, LOW);
  analogWrite(MOTOR1.enable, pwm);
}

void back(int pwm) // первый назад
{
  digitalWrite(MOTOR1.in1, LOW);
  digitalWrite(MOTOR1.in2, HIGH);
  analogWrite(MOTOR1.enable, pwm);
}

void gpss()
{
  while (digitalRead(gpsButton) == HIGH) {
    gpsON();
  }
}


void gpsON() {
  for (int i = 0; i < 100; i++) {
    display.clearDisplay();
    display.drawBitmap(0, 0, gpsbmp, 84, 44, BLACK);
    display.display();
    while (uart_gps.available())
    {
      int c = uart_gps.read();
      if (gps.encode(c))
      {
        getgps(gps);
      }
    }
  }
  display.clearDisplay();  display.display();
}
void getgps(TinyGPS &gps)
{
  int year;
  float latitude, longitude;
  byte month, day, hour, minute, second, hundredths;
  unsigned long age;
  gps.f_get_position(&latitude, &longitude);
  gps.crack_datetime(&year, &month, &day, &hour, &minute, &second, &hundredths, &age);
  hour = hour + timeoffset;
  display.clearDisplay();
  display.display();
  display.print("TIME:         ");
  display.display();

  if (hour <= 9)
  {
    display.print("0"); display.print(hour, DEC); display.display();
  }
  else
  {
    display.print(hour, DEC); display.display();
  }
  display.print(":"); display.display();
  if (minute <= 9)
  {
    display.print("0"); display.print(minute, DEC); display.display();
  }
  else
  {
    display.print(minute, DEC); display.display();
  }
  display.print(":"); display.display();
  if (second <= 9)
  {
    display.print("0"); display.print(second, DEC); display.display();
  }
  else
  {
    display.print(second, DEC); display.display();
  }

  display.print("      DATE:         "); display.display();
  char buff[10];
  sprintf(buff, "%02d-%02d-%02d", day, month, year);
  display.print(buff); display.display();
  delay(2000);
  display.clearDisplay(); display.display();
  display.print("SHIROTA:      "); display.print(latitude, DEC); display.display();
  display.print(" DOLGOTA:      "); display.print(longitude, DEC); display.display();
  dolgotaMestaNum = longitude;
  shirotaNum = latitude;
  delay(2000);
}

void menu() {


  int x, y;
  int item0, item1, item2, item3, level = 0;
  while (MenuButton == HIGH) {
    delay(250);
    MenuButton = digitalRead(MenuPin);
    x = analogRead(gor);
    y = analogRead(ver);
    if (level == 0 && item0 == 0) {
      display.clearDisplay();
      display.display();
      display.drawBitmap(0, 0, menul1bmp, 84, 44, BLACK);
      display.display();
    }
    if (level == 0 && item0 == 1) {
      display.clearDisplay();
      display.display();
      display.drawBitmap(0, 0, menul2bmp, 84, 44, BLACK);
      display.display();
    }
    if (level == 0 && item0 == 2) {
      display.clearDisplay();
      display.display();
      display.drawBitmap(0, 0, menul3bmp, 84, 44, BLACK);
      display.display();
    }
    if (level == 0 && item0 == 3) {
      display.clearDisplay();
      display.display();
      display.drawBitmap(0, 0, menul4bmp, 84, 44, BLACK);
      display.display();
    }
    if (level == 0 && item0 == 4) {
      display.clearDisplay();
      display.display();
      display.drawBitmap(0, 0, menul5bmp, 84, 44, BLACK);
      display.display();
    }

    if (level == 1 && item0 == 0 && item1 == 0) {
      display.clearDisplay();
      display.display();
      display.drawBitmap(0, 0, Dolgotabmp, 84, 44, BLACK);
      display.display();
    }
    if (level == 1 && item0 == 0 && item1 == 1) {
      display.clearDisplay();
      display.display();
      display.drawBitmap(0, 0, Shirotabmp, 84, 44, BLACK);
      display.display();
    }
    if (level == 1 && item0 == 0 && item1 == 2) {
      display.clearDisplay();
      display.display();
      display.drawBitmap(0, 0, Kompasbmp, 84, 44, BLACK);
      display.display();
    }
  
    if (level == 2 && item0 == 0 && item1 == 0) {
 
    kpress = keypad.getKey();
    display.clearDisplay();
    display.drawBitmap(0, 0, dolgotambmp, 84, 44, BLACK);
    display.setCursor(0,30);
    display.print(dolgotaMestaNum);
    display.display();
    digitalWrite(LedDolgotaMestaPin, HIGH);

    if (kpress == 'C')
    {
      dolgotaMestaNum = 0;
      display.clearDisplay();
      display.display();

    }
    if ( kpress >= '0' && kpress <= '9')
    {
      dolgotaMestaNum = dolgotaMestaNum * 10 + (kpress - '0');

    }
    if (kpress == '-') {
      dolgotaMestaNum = dolgotaMestaNum - dolgotaMestaNum * 2;
    }

    }
  
    if (level == 2 && item0 == 0 && item1 == 1){}
    if (level == 2 && item0 == 0 && item1 == 2){}

    if (level == 1 && item0 == 1 && item2 == 0){}
// до 96
  


    
    if (x > 600) {

      level = level + 1;
      level = constrain(level, 0, 2);
    }
    if (x < 450) {
      level = level - 1;
      level = constrain(level, 0, 2);
    }
    if (y > 600) {
      if (level == 0) {
        item0 = item0 - 1;
item1, item2 = 0;
        item0 = constrain(item0, 0, 4);
      }
           if (level == 1) {
        item1 = item1 - 1;
        item1 = constrain(item1, 0, 2);
        item2 = item2 - 1;
        item2 = constrain(item2, 0, 95);
      }
    }
    if (y < 450) {
      if (level == 0) {
        item0 = item0 + 1;
        item0 = constrain(item0, 0, 4);
        item1, item2 = 0;
      }
            if (level == 1) {
        item1 = item1 + 1;
        item1 = constrain(item1, 0, 2);
                item2 = item2 - 1;
        item2 = constrain(item2, 0, 95);
      }
    }
    if (MenuButton == LOW)
    {
      display.clearDisplay();
      display.display();
      
    }
  }

}


void melody () {
tone(7,1318,300);
delay(600);
tone(7,1318,200);
delay(600);
tone(7,1318,300);
delay(600);
tone(7,1046,150);
delay(300);
tone(7,1318,150);
delay(300);
tone(7,1568,150);
delay(300);
tone(7,784,150);
delay(300);
}

